## ble-adv-basic/build/l2_e1/Kconfig/boards/Kconfig.nrf5340dk
```kconfig
# Load board Kconfig descriptions.
osource "/home/goodbyte/ncs/v3.4.0/zephyr/boards/nordic/nrf5340dk/Kconfig.nrf5340dk"
```

## dir-mutex/mutex-advanced/build/Kconfig/boards/Kconfig.defconfig.tmp
```kconfig
# Load Zephyr board defconfig descriptions.
osource "/home/goodbyte/ncs/v3.4.0/zephyr/boards/nordic/nrf5340dk/Kconfig.defconfig"
```
